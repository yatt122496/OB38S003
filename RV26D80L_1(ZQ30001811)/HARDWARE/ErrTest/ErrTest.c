/***********************************************************
*  文件说明：
************************************************************
*  日期:
*
*  作者:  cuoiszf
*
************************************************************
*  硬件：sh79f083
************************************************************
* 【版权】 Copyright(C)鹏林电子
* 【声明】
***********************************************************/
#include "HARDWARE\main\SysInc.h"
//----------------------------
bit    GoErrCon;
//----------------------------
uint8  GoErrCount;
//----------------------------
uint16 NtcErrDat;
//----------------------------
uint8  ErrCon;
bit    OverTemp;
/************************************************************
* 函数名:
* 功能说明:
************************************************************/
void GoErrTestInit(void)
{
  GoErrCon   = 0;
  GoErrCount = 0;
}
/************************************************************
*
* 		  跳制保护检测
************************************************************/
void Int1Isr_ErrTest(void) interrupt INT0
{
  IE0  = 0;
  GoErrCount++;
  if(GoErrCount > 80)
  GoErrCount    = 90;
}
/************************************************************
*
* 功能说明:  错误分离检测
************************************************************/
void ErrTest(void)
{
  if(AdReady)
  {
	if(TempValue>=60)OverTemp=1;
	//-------------------------------
    if(GoErrCon)
	ErrCon = 3;
	else
	if(OverTemp)
	ErrCon = 1;
	else
	if((NtcErrDat>979)||(NtcErrDat<43))
	ErrCon = 2;
	else
	ErrCon = 0;
  }else
  ErrCon = 0;
}
